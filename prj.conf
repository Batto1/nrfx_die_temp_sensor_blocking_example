## CMakeLists.txt
```
# SPDX-License-Identifier: Apache-2.0

cmake_minimum_required(VERSION 3.20.0)

find_package(Zephyr REQUIRED HINTS $ENV{ZEPHYR_BASE})
project(nrf_die_temp_blocking_simple)

target_sources(app PRIVATE src/main.c)

# target_include_directories(app PUBLIC modules/hal/nordic/nrfx/samples/common)

# # Add common Kconfig file to project.
# list(APPEND CONF_FILE "${CMAKE_CURRENT_LIST_DIR}/common.conf")

# # Add project Kconfig file if it exists.
# set(PRJ_CONF_FILE "${CMAKE_CURRENT_SOURCE_DIR}/prj.conf")
# if(EXISTS ${PRJ_CONF_FILE})
#     list(APPEND CONF_FILE ${PRJ_CONF_FILE})
# endif()

# # Macro adding overlay file and Kconfig file for specified board in given directory.
# # If board-specific files have been found they are added to DTC_OVERLAY_FILE and CONF_FILE
# # symbols that are used in west build system.
# macro(GET_DEVICE_CONFIG_FILES BOARD BOARDS_DIR)
#     if(NOT IS_ABSOLUTE BOARDS_DIR)
#         set(_BOARDS_DIR ${CMAKE_CURRENT_LIST_DIR}/${BOARDS_DIR})
#         get_filename_component(BOARDS_DIR_ABSOLUTE "${_BOARDS_DIR}" ABSOLUTE)
#     else()
#         set(BOARDS_DIR_ABSOLUTE {BOARDS_DIR})
#     endif()

#     set(OVERLAY_FILE "${BOARDS_DIR_ABSOLUTE}/${BOARD}.overlay")
#     if(EXISTS ${OVERLAY_FILE})
#         list(APPEND DTC_OVERLAY_FILE "${OVERLAY_FILE}")
#     endif()

#     set(CONFIG_FILE "${BOARDS_DIR_ABSOLUTE}/${BOARD}.conf")
#     if(EXISTS ${CONFIG_FILE})
#         list(APPEND CONF_FILE "${CONFIG_FILE}")
#     endif()
# endmacro()
```

## prj.conf
```kconfig
CONFIG_NRFX_TEMP=y
```

## src/main.c
```c
/*
 * Copyright (c) 2022, Nordic Semiconductor ASA
 * All rights reserved.
 *
 * SPDX-License-Identifier: BSD-3-Clause
 *
 * Redistribution and use in source and binary forms, with or without
 * modification, are permitted provided that the following conditions are met:
 *
 * 1. Redistributions of source code must retain the above copyright notice, this
 *    list of conditions and the following disclaimer.
 *
 * 2. Redistributions in binary form must reproduce the above copyright
 *    notice, this list of conditions and the following disclaimer in the
 *    documentation and/or other materials provided with the distribution.
 *
 * 3. Neither the name of the copyright holder nor the names of its
 *    contributors may be used to endorse or promote products derived from this
 *    software without specific prior written permission.
 *
 * THIS SOFTWARE IS PROVIDED BY THE COPYRIGHT HOLDERS AND CONTRIBUTORS "AS IS"
 * AND ANY EXPRESS OR IMPLIED WARRANTIES, INCLUDING, BUT NOT LIMITED TO, THE
 * IMPLIED WARRANTIES OF MERCHANTABILITY AND FITNESS FOR A PARTICULAR PURPOSE
 * ARE DISCLAIMED. IN NO EVENT SHALL THE COPYRIGHT HOLDER OR CONTRIBUTORS BE
 * LIABLE FOR ANY DIRECT, INDIRECT, INCIDENTAL, SPECIAL, EXEMPLARY, OR
 * CONSEQUENTIAL DAMAGES (INCLUDING, BUT NOT LIMITED TO, PROCUREMENT OF
 * SUBSTITUTE GOODS OR SERVICES; LOSS OF USE, DATA, OR PROFITS; OR BUSINESS
 * INTERRUPTION) HOWEVER CAUSED AND ON ANY THEORY OF LIABILITY, WHETHER IN
 * CONTRACT, STRICT LIABILITY, OR TORT (INCLUDING NEGLIGENCE OR OTHERWISE)
 * ARISING IN ANY WAY OUT OF THE USE OF THIS SOFTWARE, EVEN IF ADVISED OF THE
 * POSSIBILITY OF SUCH DAMAGE.
 */


/** 
 *  @author https://github.com/Batto1
 *  @note example or hal libs aren't created by the given author. Only some modification in the code is made for demonstration purposes.
 *  @date 03.01.2023
 *  @board: nRF52840DK
 *  @note some lib paths 
 *  modules\hal\nordic\nrfx\samples\src\nrfx_temp // original example path
 *  
 *  modules\hal\nordic\nrfx\hal\nrf_temp.h
 *  modules\hal\nordic\nrfx\drivers\include\nrfx_temp.h
 *  modules\hal\nordic\nrfx\drivers\src\nrfx_temp.c
 * 
 *  modules\hal\nordic\nrfx\mdk\nrf52840.h
 *  modules\hal\nordic\nrfx\drivers\nrfx_common.h
 *  modules\hal\nordic\nrfx\drivers\nrfx_errors.h
*/

/**
 * @board: nRF52840DK
 * @note it takes 395ms to take 1000 consequent readings in non-blocking mode
 * @note it takes 40ms to take 1000 consequent readings in blocking mode
*/

#include <zephyr/kernel.h>
#include "inttypes.h"
#include <nrfx_temp.h>

/**
 * @brief Example shows the functionality of nrfx_temp driver operating in the blocking mode.
 *
 * @details Application initializes nrfx_temp driver and starts operating in the blocking mode.
 *          The temperature measurement and relevant message logging are performed, until a number
 *          of measurements taken is equal to the value specified by the user.
 */





/** @brief Symbol specifying the number of temperature measurements to take. */
#define TEMP_ITERATIONS 1000UL

/**
 * @brief Function for application main entry.
 *
 * @return Nothing.
 */
int main(void)
{
    nrfx_err_t status;
    (void)status;

    uint32_t i = 0;

    nrfx_temp_config_t config = NRFX_TEMP_DEFAULT_CONFIG;
    status = nrfx_temp_init(&config, NULL);
    // NRFX_ASSERT(status == NRFX_SUCCESS);

    int64_t curr_time = k_uptime_get();
    while (1)
    {
        if (i < TEMP_ITERATIONS)
        {
            status = nrfx_temp_measure();

            int32_t temperature = nrfx_temp_result_get();
            int32_t celsius_temperature = nrfx_temp_calculate(temperature);

            int32_t whole_celsius = celsius_temperature / 100;
            uint8_t fraction_celsius = NRFX_ABS(celsius_temperature % 100);

            // printk("Measured temperature: %d.%02u [C]\n", whole_celsius, fraction_celsius); // comment this when taking time measurement

            i++;
        }
        else if (i == TEMP_ITERATIONS)
        {
            nrfx_temp_uninit();
            i++;
            break;
        }
    }
    int64_t tot_time = k_uptime_delta(&curr_time);
    printk("total time it took to get %lu measurements: %"PRId64"ms\n", TEMP_ITERATIONS, tot_time);

}
```
